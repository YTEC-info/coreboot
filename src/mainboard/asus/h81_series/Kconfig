## src/mainboard/asus/h81_series/Kconfig
```kconfig
## SPDX-License-Identifier: GPL-2.0-only

if BOARD_ASUS_H81_SERIES

config BOARD_SPECIFIC_OPTIONS
	def_bool y
	select BOARD_ROMSIZE_KB_8192
	select HAVE_ACPI_RESUME
	select HAVE_ACPI_TABLES
	select INTEL_GMA_HAVE_VBT
	select MAINBOARD_HAS_LIBGFXINIT
	select MEMORY_MAPPED_TPM
	select NORTHBRIDGE_INTEL_HASWELL
	select SERIRQ_CONTINUOUS_MODE
	select SOUTHBRIDGE_INTEL_LYNXPOINT
	select SUPERIO_NUVOTON_NCT6791D
	select USE_BROADWELL_MRC if !USE_NATIVE_RAMINIT

config MAINBOARD_DIR
	string
	default "asus/h81_series"

config MAINBOARD_PART_NUMBER
	string
	default "H81"

config CBFS_SIZE
	default 0x200000

endif
```

## src/mainboard/asus/h81_series/Kconfig.name
```kconfig
## SPDX-License-Identifier: GPL-2.0-only

config BOARD_ASUS_H81_SERIES
	bool "H81"
```

## src/mainboard/asus/h81m-a/Kconfig
```kconfig
## SPDX-License-Identifier: GPL-2.0-only

if BOARD_ASUS_H81M_A

config BOARD_SPECIFIC_OPTIONS
	def_bool y
	select BOARD_ROMSIZE_KB_8192
	select HAVE_ACPI_RESUME
	select HAVE_ACPI_TABLES
	select INTEL_GMA_HAVE_VBT
	select MAINBOARD_HAS_LIBGFXINIT
	select MEMORY_MAPPED_TPM
	select NORTHBRIDGE_INTEL_HASWELL
	select SERIRQ_CONTINUOUS_MODE
	select SOUTHBRIDGE_INTEL_LYNXPOINT
	select SUPERIO_NUVOTON_NCT5539D
	select SUPERIO_NUVOTON_NCT5539D_COM_A
	select USE_NATIVE_RAMINIT
	
config MAINBOARD_DIR
	string
	default "asus/h81m-a"

config MAINBOARD_PART_NUMBER
	string
	default "H81M-A"

config CBFS_SIZE
	default 0x200000

endif
```

## src/mainboard/asus/h81m-a/Kconfig.name
```kconfig
## SPDX-License-Identifier: GPL-2.0-only

config BOARD_ASUS_H81M_A
	bool "H81M-A"
```

## src/mainboard/ecs/Kconfig
```kconfig
## SPDX-License-Identifier: GPL-2.0-only

if VENDOR_ECS

choice
	prompt "Mainboard model"

source "src/mainboard/ecs/*/Kconfig.name"

endchoice

source "src/mainboard/ecs/*/Kconfig"

config MAINBOARD_VENDOR
	string
	default "ECS"

endif # VENDOR_ECS
```

## src/mainboard/ecs/h310ch5/Kconfig
```kconfig
## SPDX-License-Identifier: GPL-2.0-only

if BOARD_ECS_H310CH5

config BOARD_SPECIFIC_OPTIONS
	def_bool y
	select BOARD_ROMSIZE_KB_8192
	select CONSOLE_SERIAL
	select DRIVERS_UART_8250IO
	select HAVE_ACPI_RESUME
	select HAVE_ACPI_TABLES
	select HAVE_OPTION_TABLE
	select HAVE_CMOS_DEFAULT
	select INTEL_GMA_HAVE_VBT
	select INTEL_INT15
	select MEMORY_MAPPED_TPM
	#select MAINBOARD_SUPPORTS_SKYLAKE_CPU
	#select MAINBOARD_SUPPORTS_KABYLAKE_CPU
	select MAINBOARD_SUPPORTS_COFFEELAKE_CPU
	select SOC_INTEL_KABYLAKE
	#select SKYLAKE_SOC_PCH_H
	select SOC_INTEL_SKYLAKE_LGA1151_V2
	select SUPERIO_ITE_IT8613E

config DISABLE_HECI1_AT_PRE_BOOT
	default y

config MAINBOARD_DIR
	default "ecs/h310ch5"

config MAINBOARD_PART_NUMBER
	default "H310CH5"

config PRERAM_CBMEM_CONSOLE_SIZE
	hex
	default 0xd00

config DIMM_SPD_SIZE
	default 512 #DDR4

config CBFS_SIZE
	default 0x600000 # 8mb chip, 2mb available

config CONSOLE_POST
	default y
	
#config USBDEBUG_HCD_INDEX
	#default 2

endif
```

## src/mainboard/ecs/h310h5/Kconfig
```kconfig
if BOARD_ECS_H310H5

config BOARD_SPECIFIC_OPTIONS
	def_bool y
	select BOARD_ROMSIZE_KB_8192
	select HAVE_ACPI_RESUME
	select HAVE_ACPI_TABLES
	#select HAVE_OPTION_TABLE
	select SOC_INTEL_COFFEELAKE
	select SOC_INTEL_CANNONLAKE_PCH_H
	select SUPERIO_ITE_IT8613E
	select DRIVERS_UART_8250IO
	select MEMORY_MAPPED_TPM
	select CONSOLE_SERIAL
	select DRIVERS_UART_8250IO

#config DISABLE_HECI1_AT_PRE_BOOT
#	default y

config MAINBOARD_DIR
	default "ecs/h310h5"

config MAINBOARD_PART_NUMBER
	default "H310H5"

config PRERAM_CBMEM_CONSOLE_SIZE
	hex
	default 0xd00

config DIMM_SPD_SIZE
	default 512 #DDR4

config CBFS_SIZE
	default 0xa00000 # 12mb available

endif
```

## src/mainboard/gigabyte/ga-p41-es3g/Kconfig
```kconfig
# SPDX-License-Identifier: GPL-2.0-only

if BOARD_GIGABYTE_GA_P41_ES3G

config BOARD_SPECIFIC_OPTIONS
	def_bool y
	select CPU_INTEL_SOCKET_LGA775
	select NORTHBRIDGE_INTEL_X4X
	select SOUTHBRIDGE_INTEL_I82801GX
	select SUPERIO_ITE_IT8718F
	select HAVE_ACPI_TABLES
	select BOARD_ROMSIZE_KB_1024
	select PCIEXP_ASPM
	select PCIEXP_CLK_PM
	select PCIEXP_L1_SUB_STATE
	select REALTEK_8168_RESET
	select HAVE_OPTION_TABLE
	select HAVE_CMOS_DEFAULT
	select HAVE_ACPI_RESUME

config MAINBOARD_DIR
	default "gigabyte/ga-p41-es3g"

config MAINBOARD_PART_NUMBER
	default "GA_P41_ES3G"

endif # BOARD_GIGABYTE_GA_P41_ES3G
```

## src/mainboard/lenovo/ih61m/Kconfig
```kconfig
if BOARD_LENOVO_IH61MV1 || BOARD_LENOVO_IH61MV4

config BOARD_SPECIFIC_OPTIONS
	def_bool y
	select BOARD_ROMSIZE_KB_4096 if BOARD_LENOVO_IH61MV1 #W25Q32(4MB)
	select BOARD_ROMSIZE_KB_6144 if BOARD_LENOVO_IH61MV4 #W25Q32+W25Q16(6MB) 
	select HAVE_ACPI_RESUME
	select HAVE_ACPI_TABLES
	select HAVE_CMOS_DEFAULT
	select HAVE_OPTION_TABLE
	select INTEL_GMA_HAVE_VBT
	select INTEL_INT15
	select MAINBOARD_HAS_LIBGFXINIT
	select NORTHBRIDGE_INTEL_SANDYBRIDGE
	select SERIRQ_CONTINUOUS_MODE
	select SOUTHBRIDGE_INTEL_BD82X6X
	select SUPERIO_NUVOTON_NCT6776
	select USE_NATIVE_RAMINIT

config MAINBOARD_DIR
	default "lenovo/ih61m"

config MAINBOARD_PART_NUMBER
	default "IH61M Ver:1.0" if BOARD_LENOVO_IH61MV1
	default "IH61M Ver:4.2" if BOARD_LENOVO_IH61MV4

config DRAM_RESET_GATE_GPIO # FIXME: check this
	int
	default 60

config USBDEBUG_HCD_INDEX # FIXME: check this
	int
	default 2
endif
```

## src/mainboard/lenovo/ih61m/Kconfig.name
```kconfig
config BOARD_LENOVO_IH61MV1
	bool "IH61M Ver:1.0"

config BOARD_LENOVO_IH61MV4
	bool "IH61M Ver:4.2"
```

## src/mainboard/lenovo/is7xm/Kconfig.name
```kconfig
## SPDX-License-Identifier: GPL-2.0-only

config BOARD_LENOVO_IS7XM
	bool "IS7XM"
```

## src/mainboard/lenovo/thinkcentre_m92p/Kconfig
```kconfig
## SPDX-License-Identifier: GPL-2.0-only

if BOARD_LENOVO_THINKCENTRE_M92P

config BOARD_SPECIFIC_OPTIONS
	def_bool y
	select BOARD_ROMSIZE_KB_10240
	select HAVE_ACPI_RESUME
	select HAVE_ACPI_TABLES
	select HAVE_CMOS_DEFAULT
	select HAVE_OPTION_TABLE
	select INTEL_GMA_HAVE_VBT
	select INTEL_INT15
	select MAINBOARD_HAS_LIBGFXINIT
	select NORTHBRIDGE_INTEL_SANDYBRIDGE
	select SERIRQ_CONTINUOUS_MODE
	select SOUTHBRIDGE_INTEL_C216
	select USE_NATIVE_RAMINIT

config MAINBOARD_DIR
	string
	default "lenovo/thinkcentre_m92p"

config MAINBOARD_PART_NUMBER
	string
	default "ThinkCentre M92p"

config VGA_BIOS_ID
	string
	default "8086,0152"

config DRAM_RESET_GATE_GPIO # FIXME: check this
	int
	default 10

config USBDEBUG_HCD_INDEX # FIXME: check this
	int
	default 2
endif
```

## src/mainboard/lenovo/thinkcentre_m92p/Kconfig.name
```kconfig
## SPDX-License-Identifier: GPL-2.0-only

config BOARD_LENOVO_THINKCENTRE_M92P
	bool "ThinkCentre M92p"
```

## src/mainboard/positivo/pos-pig41bo/Kconfig.name
```kconfig
## SPDX-License-Identifier: GPL-2.0-only

config BOARD_POSITIVO_POS-PIG41BO
	bool "POS-PIG41BO"
```
